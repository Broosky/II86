/////////////////////////////////////////////////////////////////////////////////////////////////////////////////////////////
// Project: II86                                                                                                           //
// Author: Jeffrey Bednar                                                                                                  //
// Copyright (c) Illusion Interactive, 2011 - 2026.                                                                        //
/////////////////////////////////////////////////////////////////////////////////////////////////////////////////////////////
// Educational Use Notice:                                                                                                 //
/////////////////////////////////////////////////////////////////////////////////////////////////////////////////////////////
// This project is provided for educational and learning purposes only. You are welcome to read, study, and experiment     //
// with this software and/or hardware. It is not intended for commercial use. This software and/or hardware is provided    //
// "as is", without warranty of any kind. The author assumes no responsibility for any damages or issues resulting from    //
// its use.                                                                                                                //
/////////////////////////////////////////////////////////////////////////////////////////////////////////////////////////////
// Date: Monday, February 28th, 2024
// Description: Time based external event executor.
/////////////////////////////////////////////////////////////////////////////////////////////////////////////////////////////
// Fold all: Ctrl + K + 0
// Unfold all: Ctrl + K + J
// Show file explorer: Ctrl + Shift + E
/////////////////////////////////////////////////////////////////////////////////////////////////////////////////////////////
#include "Headers/profiles.h"
#include <TimeLib.h>
/////////////////////////////////////////////////////////////////////////////////////////////////////////////////////////////
// Program constants.
/////////////////////////////////////////////////////////////////////////////////////////////////////////////////////////////
const uint8_t FW_VERSION_MAJOR = 1;
const uint8_t FW_VERSION_MINOR = 0;
const uint8_t FW_VERSION_PATCH = 0;
/////////////////////////////////////////////////////////////////////////////////////////////////////////////////////////////
const uint8_t PIN_OUTPUT_LED_YELLOW = 8;
const uint8_t PIN_OUTPUT_LED_RED = 7;
const uint8_t PIN_OUTPUT_TIP41_BASE = 9;  // PWM
const uint8_t PIN_INPUT_BUTTON = 2;
/////////////////////////////////////////////////////////////////////////////////////////////////////////////////////////////
const uint8_t TRIGGER_NORMAL_CYCLES = 3;
const uint8_t TRIGGER_TEST_CYCLES = 1;
const uint8_t BUTTON_DEBOUNCE_DELAY_MS = 100;
const unsigned long BUTTON_ENTER_CADENCE_MODE_DELAY_SECONDS = 60;  // Must be unsigned long.
const unsigned long CADENCE_MODE_CYCLIC_INTERVAL_SECONDS = 300;    // Must be unsigned long.
/////////////////////////////////////////////////////////////////////////////////////////////////////////////////////////////
// Globals and counters.
/////////////////////////////////////////////////////////////////////////////////////////////////////////////////////////////
unsigned long debounceLastTimeMs = 0;
unsigned long cadenceModeLastConsideredTimeMs = 0;
unsigned long cadenceModeLastTriggerTimeMs = 0;
uint8_t buttonStateLast = LOW;
uint8_t (*activeProfile)[CONSIDER_DAYS_COUNT][CONSIDER_TIMES_COUNT][VALUES] = NULL;
/////////////////////////////////////////////////////////////////////////////////////////////////////////////////////////////
// Initial setup.
/////////////////////////////////////////////////////////////////////////////////////////////////////////////////////////////
void setup(void) {
  Serial.begin(9600);
  ///////////////////////////////////////////////////////////////////////////////////////////////////////////////////////////
  pinMode(PIN_INPUT_BUTTON, INPUT);
  pinMode(PIN_OUTPUT_TIP41_BASE, OUTPUT);
  pinMode(PIN_OUTPUT_LED_RED, OUTPUT);
  pinMode(PIN_OUTPUT_LED_YELLOW, OUTPUT);
  ///////////////////////////////////////////////////////////////////////////////////////////////////////////////////////////
  setupTime();
  setupPrintTime();
  setupSeed();
  ///////////////////////////////////////////////////////////////////////////////////////////////////////////////////////////
  // Test all the things.
  ///////////////////////////////////////////////////////////////////////////////////////////////////////////////////////////
  ///*
  blinkYellowLed(8, 250);
  blinkRedLed(8, 250);
  blinkAllLeds(8, 250);
  triggerEvent(TRIGGER_TEST_CYCLES);
  //*/
}
/////////////////////////////////////////////////////////////////////////////////////////////////////////////////////////////
// Main program loop.
/////////////////////////////////////////////////////////////////////////////////////////////////////////////////////////////
void loop() {
  if (considerTestMode()) {
    setupCadenceMode();
    if (considerCadenceMode()) {
      blinkRedLed(1, 250);
      if (considerCadenceModeTrigger()) {
        triggerEvent(TRIGGER_TEST_CYCLES);
      }
    } else {
      triggerEvent(TRIGGER_TEST_CYCLES);
    }
  } else {
    resetCadenceModeTrigger();
    resetCadenceMode();
    runProgram();
  }
  delay(1000);
}
/////////////////////////////////////////////////////////////////////////////////////////////////////////////////////////////
// The main program. Consider triggering the event if the current day and time intersects with the expected day's times with up to a minute of accuracy.
/////////////////////////////////////////////////////////////////////////////////////////////////////////////////////////////
void runProgram() {
  static int lastWeekday = 0, profile = 0;

  int nowWeekday = weekday();
  int nowHour = hour();
  int nowMinute = minute();

  if (nowWeekday != lastWeekday) {
    lastWeekday = nowWeekday;
    profile = getProfile();
  }

  blinkYellowLed(profile + 1, 100);
  activeProfile = &profiles[profile];

  switch (nowWeekday) {
    // Sunday
    case 1:
    case 2:
    case 3:
    case 4:
    case 5:
    case 6:
    case 7:
      {
        for (uint8_t i = 0; i < CONSIDER_TIMES_COUNT; i++) {
          if (considerTriggerEvent(nowHour, activeProfile[nowWeekday - 1][i][0], nowMinute, activeProfile[nowWeekday - 1][i][1])) {
            triggerEvent(TRIGGER_NORMAL_CYCLES);
          }
        }
        break;
      }
    default:
      {
        break;
      }
  }
}
/////////////////////////////////////////////////////////////////////////////////////////////////////////////////////////////
// Which profile to run.
/////////////////////////////////////////////////////////////////////////////////////////////////////////////////////////////
uint8_t getProfile() {
  return random(CONSIDER_PROFILES_COUNT);
}
/////////////////////////////////////////////////////////////////////////////////////////////////////////////////////////////
// Blinks the red LED.
/////////////////////////////////////////////////////////////////////////////////////////////////////////////////////////////
void blinkRedLed(uint8_t times, uint16_t delayMs) {
  for (uint8_t i = 0; i < times; i++) {
    digitalWrite(PIN_OUTPUT_LED_RED, HIGH);
    delay(delayMs);
    digitalWrite(PIN_OUTPUT_LED_RED, LOW);
    if (times > 1 && i + 1 < times) {
      delay(delayMs);
    }
  }
}
/////////////////////////////////////////////////////////////////////////////////////////////////////////////////////////////
// Blinks the yellow LED.
/////////////////////////////////////////////////////////////////////////////////////////////////////////////////////////////
void blinkYellowLed(uint8_t times, uint16_t delayMs) {
  for (uint8_t i = 0; i < times; i++) {
    digitalWrite(PIN_OUTPUT_LED_YELLOW, HIGH);
    delay(delayMs);
    digitalWrite(PIN_OUTPUT_LED_YELLOW, LOW);
    if (times > 1 && i + 1 < times) {
      delay(delayMs);
    }
  }
}
/////////////////////////////////////////////////////////////////////////////////////////////////////////////////////////////
// Blinks all LED's.
/////////////////////////////////////////////////////////////////////////////////////////////////////////////////////////////
void blinkAllLeds(uint8_t times, uint16_t delayMs) {
  for (uint8_t i = 0; i < times; i++) {
    digitalWrite(PIN_OUTPUT_LED_RED, HIGH);
    digitalWrite(PIN_OUTPUT_LED_YELLOW, HIGH);
    delay(delayMs);
    digitalWrite(PIN_OUTPUT_LED_RED, LOW);
    digitalWrite(PIN_OUTPUT_LED_YELLOW, LOW);
    if (times > 1 && i + 1 < times) {
      delay(delayMs);
    }
  }
}
/////////////////////////////////////////////////////////////////////////////////////////////////////////////////////////////
// Sets the Arduino's clock to the compiled time of the program.
/////////////////////////////////////////////////////////////////////////////////////////////////////////////////////////////
void setupTime() {
  const char compileTime[] = __DATE__ " " __TIME__;
  const char monthAbbreviations[] = "JanFebMarAprMayJunJulAugSepOctNovDec";
  char monthBuffer[16];
  int nowHour, nowMinute, nowSecond, nowDay, nowYear = 0;
  sscanf(compileTime, "%s %d %d %d:%d:%d", monthBuffer, &nowDay, &nowYear, &nowHour, &nowMinute, &nowSecond);
  int nowMonth = (strstr(monthAbbreviations, monthBuffer) - monthAbbreviations) / 3 + 1;
  setTime(nowHour, nowMinute, nowSecond, nowDay, nowMonth, nowYear);
}
/////////////////////////////////////////////////////////////////////////////////////////////////////////////////////////////
// Writes whatever the Arduino's configured clock was set as to the serial console.
/////////////////////////////////////////////////////////////////////////////////////////////////////////////////////////////
void setupPrintTime() {
  char buffer[19];
  sprintf(buffer, "%4d-%02d-%02d %02d:%02d:%02d", year(), month(), day(), hour(), minute(), second());
  Serial.println(buffer);
}
/////////////////////////////////////////////////////////////////////////////////////////////////////////////////////////////
// Seed by mixing analog noise and runtime for a higher degree of entropy.
/////////////////////////////////////////////////////////////////////////////////////////////////////////////////////////////
void setupSeed() {
  unsigned long seed = 0;

  for (uint8_t i = 0; i < 32; i++) {
    for (uint8_t pin = A0; pin <= A5; pin++) {
      seed ^= analogRead(pin) << (i % 16);
    }
    seed ^= micros();
    delay(5);
  }

  randomSeed(seed);
}
/////////////////////////////////////////////////////////////////////////////////////////////////////////////////////////////
// Prerequisite configuration for the check that decides if we enter cadence mode. Set an initial starting time.
/////////////////////////////////////////////////////////////////////////////////////////////////////////////////////////////
void setupCadenceMode() {
  if (cadenceModeLastConsideredTimeMs == 0) {
    cadenceModeLastConsideredTimeMs = millis();
  }
}
/////////////////////////////////////////////////////////////////////////////////////////////////////////////////////////////
// Prerequisite configuration for the check that decides if we trigger an event while in cadence mode. Set an initial starting time.
/////////////////////////////////////////////////////////////////////////////////////////////////////////////////////////////
void setupCadenceModeTrigger() {
  if (cadenceModeLastTriggerTimeMs == 0) {
    cadenceModeLastTriggerTimeMs = millis();
  }
}
/////////////////////////////////////////////////////////////////////////////////////////////////////////////////////////////
// Reset cadence mode checking for next cycle.
/////////////////////////////////////////////////////////////////////////////////////////////////////////////////////////////
void resetCadenceMode() {
  cadenceModeLastConsideredTimeMs = 0;
}
/////////////////////////////////////////////////////////////////////////////////////////////////////////////////////////////
// Reset cadence mode trigger checking for next cycle.
/////////////////////////////////////////////////////////////////////////////////////////////////////////////////////////////
void resetCadenceModeTrigger() {
  cadenceModeLastTriggerTimeMs = 0;
}
/////////////////////////////////////////////////////////////////////////////////////////////////////////////////////////////
// Considers if the current time should trigger the event within a minute of accuracy.
/////////////////////////////////////////////////////////////////////////////////////////////////////////////////////////////
uint8_t considerTriggerEvent(int nowHour, int considerHour, int nowMinute, int considerMinute) {
  uint8_t triggerEvent = false;

  if (nowHour >= considerHour && nowHour < considerHour + 1 && nowMinute >= considerMinute && nowMinute < considerMinute + 1) {
    triggerEvent = true;
  }

  return triggerEvent;
}
/////////////////////////////////////////////////////////////////////////////////////////////////////////////////////////////
// Considers if the program is in test mode. This will trigger the event if the button is pressed, and engage cadence mode if
// the button is pressed long enough.
/////////////////////////////////////////////////////////////////////////////////////////////////////////////////////////////
uint8_t considerTestMode() {
  uint8_t performTest = false;
  uint8_t reading = digitalRead(PIN_INPUT_BUTTON);
  unsigned long currentMs = millis();

  if (reading != buttonStateLast) {
    debounceLastTimeMs = currentMs;
  }

  if ((currentMs - debounceLastTimeMs) > BUTTON_DEBOUNCE_DELAY_MS) {
    if (reading == HIGH) {
      performTest = true;
    }
  }

  buttonStateLast = reading;

  return performTest;
}
/////////////////////////////////////////////////////////////////////////////////////////////////////////////////////////////
// Considers if the program will enter cadence mode. If the button is pressed long enough, begin triggering the event at a longer prescribed interval.
/////////////////////////////////////////////////////////////////////////////////////////////////////////////////////////////
uint8_t considerCadenceMode() {
  uint8_t considerCadenceMode = false;
  unsigned long currentMs = millis();

  if ((currentMs - cadenceModeLastConsideredTimeMs) >= BUTTON_ENTER_CADENCE_MODE_DELAY_SECONDS * 1000) {
    setupCadenceModeTrigger();
    considerCadenceMode = true;
  }

  return considerCadenceMode;
}
/////////////////////////////////////////////////////////////////////////////////////////////////////////////////////////////
// Considers if the program will trigger a cadence mode event. This is the longer prescribed interval.
/////////////////////////////////////////////////////////////////////////////////////////////////////////////////////////////
uint8_t considerCadenceModeTrigger() {
  uint8_t performCadenceModeTrigger = false;
  unsigned long currentMs = millis();

  if ((currentMs - cadenceModeLastTriggerTimeMs) >= CADENCE_MODE_CYCLIC_INTERVAL_SECONDS * 1000) {
    cadenceModeLastTriggerTimeMs = currentMs;
    performCadenceModeTrigger = true;
  }

  return performCadenceModeTrigger;
}
/////////////////////////////////////////////////////////////////////////////////////////////////////////////////////////////
// Triggers the event.
/////////////////////////////////////////////////////////////////////////////////////////////////////////////////////////////
// Total time @ 1: 6.5 seconds.
// Total time @ 3: 19.5 seconds.
/////////////////////////////////////////////////////////////////////////////////////////////////////////////////////////////
void triggerEvent(uint8_t cycleCount) {
  for (uint8_t i = 0; i < cycleCount; i++) {
    digitalWrite(PIN_OUTPUT_LED_RED, HIGH);

    // Full -> taper
    analogWrite(PIN_OUTPUT_TIP41_BASE, 255);
    delay(500);
    analogWrite(PIN_OUTPUT_TIP41_BASE, 75);
    delay(5000);
    analogWrite(PIN_OUTPUT_TIP41_BASE, 0);

    digitalWrite(PIN_OUTPUT_LED_RED, LOW);
    delay(1000);
  }
}
/////////////////////////////////////////////////////////////////////////////////////////////////////////////////////////////